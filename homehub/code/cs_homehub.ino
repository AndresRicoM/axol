/*
  
   █████╗ ██╗  ██╗ ██████╗ ██╗     
  ██╔══██╗╚██╗██╔╝██╔═══██╗██║     
  ███████║ ╚███╔╝ ██║   ██║██║     
  ██╔══██║ ██╔██╗ ██║   ██║██║     
  ██║  ██║██╔╝ ██╗╚██████╔╝███████╗
  ╚═╝  ╚═╝╚═╝  ╚═╝ ╚═════╝ ╚══════╝

  ᓬ(• - •)ᕒ 
           
  Axol sensing system. 

   Code for Homehub Firmware. HomeHub connects to a mesh of sensors and serves as a relay for data coming to and from the sensor system. 
   The device has a built in OLED screen for data visualization. 
   
   Andres Rico - aricom@mit.edu
  
 */

#include <WiFi.h>
#include <Wire.h>
#include <SPI.h>
#include <NTPClient.h>
#include <HTTPClient.h>
#include <ArduinoJson.h>
#include <Adafruit_SSD1306.h>
#include <Adafruit_GFX.h>
#include <esp_now.h>
#include <AsyncTCP.h>
#include <ESPAsyncWebServer.h>

//Screen Variables
#define SCREEN_WIDTH 128 // OLED display width, in pixels
#define SCREEN_HEIGHT 64 // OLED display height, in pixels

// Declaration for an SSD1306 display connected to I2C (SDA, SCL pins)
#define OLED_RESET     -1 // Reset pin # (or -1 if sharing Arduino reset pin)
Adafruit_SSD1306 display(SCREEN_WIDTH, SCREEN_HEIGHT, &Wire, OLED_RESET);

#define LOGO_HEIGHT   60  //CS logo Size in pixels
#define LOGO_WIDTH    60

#define WWIDTH  21  //Water Drop Size in pixels
#define WHEIGHT 30

static const unsigned char PROGMEM cs_logo_bmp[] =
{
  B00000000, B00000000, B00000000, B00000000, B00000000, B00000000, B00000000, B00000000,
  B00000000, B00000000, B00000000, B00000000, B00000000, B00000000, B00000000, B00000000,
  B00000000, B00000000, B00000000, B00000000, B00000000, B00000000, B00000000, B00000000,
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  B00000000, B00000000, B00000000, B00000000, B00000000, B00000000, B00000000, B00000000
};



const unsigned char happy_axol_bmp[] PROGMEM = {
  
  B00000000,B00000000,B11111111,B00000000,B00000000,B00000000,B00000000,B00000000,B00000000,B00000000,B00001111,B11110000,B00000000,B00001111,
  B00000000,B00000000,B11111111,B00000000,B00000000,B00000000,B00000000,B00000000,B00000000,B00000000,B00001111,B11110000,B00000000,B00001111,
  B00000000,B00000000,B11111111,B00000000,B00000000,B00000000,B00000000,B00000000,B00000000,B00000000,B00001111,B11110000,B00000000,B00001111,
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  B00000000,B00000000,B00000000,B00000000,B11111111,B11111111,B11111111,B11111111,B11111111,B11110000,B00000000,B00000000,B00000000,B00001111

};

const unsigned char sad_axol_bmp[] PROGMEM = {
  B00000000,B00000000,B00000001,B11111111,B00000000,B00111111,B11111111,B11111111,B11111111,B11111111,B11100000,B00000111,B11111100,B00000000,B00000000,B00000111,
  B00000000,B00000000,B00000001,B11111111,B00000000,B00111111,B11111111,B11111111,B11111111,B11111111,B11100000,B00000111,B11111100,B00000000,B00000000,B00000111,
  B00000000,B00000000,B00000001,B11111111,B00000000,B00111111,B11111111,B11111111,B11111111,B11111111,B11100000,B00000111,B11111100,B00000000,B00000000,B00000111,
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  B00000111,B11111100,B00000000,B00000000,B00000000,B00000000,B00000000,B00000000,B00000000,B00000000,B00000000,B00000000,B00000000,B00000001,B11111111,B00000111
};


const unsigned char snow_bmp[] PROGMEM = {
  B11100000, B00011100, B11100000, B00011111,
  B11100000, B00011100, B11100000, B00011111,
  B11100000, B00011100, B11100000, B00011111,
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  B11100000, B00011100, B11100000, B00011111
};

const unsigned char cloud_bmp[] PROGMEM = {
  B00000000, B00011111, B11111000, B00000011,
  B00000000, B00011111, B11111000, B00000011,
  B00000000, B01111111, B11111111, B00000011,
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  B00111111, B11111111, B11111111, B11111111
};


const unsigned char rain_bmp[] PROGMEM = {
  B00000000, B00011111, B11111000, B00000011,
  B00000000, B00011111, B11111000, B00000011,
  B00000000, B01111111, B11111111, B00000011,
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  B00000011, B11000000, B11100000, B00000011
};

const unsigned char storm_bmp[] PROGMEM = {
  B00000000, B00011111, B11111000, B00000011,
  B00000000, B00011111, B11111000, B00000011,
  B00000000, B01111111, B11111111, B00000011,
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  B00000000, B01110000, B00000000, B00000011
};

const unsigned char sun_bmp[] PROGMEM = {
  B00000000, B00000111, B10000000, B00000011,
  B00000000, B00000111, B10000000, B00000011,
  B00111100, B00000111, B10000000, B11110011,
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  B00000000, B00000111, B10000000, B00000011
};



//WIFI Variables
const char* ssid = ""; //Change accordingly to connect to a WIFi network.
const char* password = "";

//Time Server Variables
WiFiUDP ntpUDP;
NTPClient timeClient(ntpUDP);
String formattedDate;
String dayStamp;
String timeStamp;

//Location Variables
float lat, lon;

//Weather/Location Server Variables
StaticJsonDocument<1024> doc;
float coord_lon = doc["coord"]["lon"];
float coord_lat = doc["coord"]["lat"];
JsonObject weather_0;
int weather_0_id = weather_0["id"];
const char* weather_0_main = weather_0["main"];
const char* weather_0_description = weather_0["description"];
const char* weather_0_icon = weather_0["icon"];
const char* base = doc["base"];
JsonObject main1;
float main_temp = main1["temp"];
float main_feels_like = main1["feels_like"];
float main_temp_min = main1["temp_min"];
float main_temp_max = main1["temp_max"];
int main_pressure = main1["pressure"];
int main_humidity = main1["humidity"];
int main_sea_level = main1["sea_level"];
int main_grnd_level = main1["grnd_level"];
int visibility = doc["visibility"];
JsonObject wind;
float wind_speed = wind["speed"];
int wind_deg = wind["deg"];
float wind_gust = wind["gust"];
int clouds_all = doc["clouds"]["all"];
long dt = doc["dt"];
JsonObject sys;
int sys_type = sys["type"];
long sys_id = sys["id"];
const char* sys_country = sys["country"];
long sys_sunrise = sys["sunrise"];
long sys_sunset = sys["sunset"];
int timezone = doc["timezone"];
long id = doc["id"];
const char* city_name = doc["name"];
int cod = doc["cod"];

//Control Variables
int bucket_count = 0;
int current_liters = 100;
bool received_message = false;

//ESP Now Communication Variables
typedef struct struct_message {
  char id[50];
  int type;
  int data1;
  int data2;
  int data3;
  int data4;
  int data6;
  int data7;
} struct_message;

struct_message myData;

//Timed Event Variables - used to send
long current_time, elapsed_time, sent_time;
bool sending_climate = true;
bool sending_activity = false;

//Water Management Variables
int buckets, tanks, quality, envs, avail_storage , avail_liters;
float fill_percentage; 
const char* dev_name;

int activity;

float up = 27;
float down = 15;
float right = 13;
float left = 14;
float a = 2;
float b = 4;

unsigned long previousMillis = 0; //WiFi Reconnecting Variables
unsigned long interval = 5000;

void setup() {
  // Begin
  Serial.begin(115200);
  Serial.println("Hello, I'm the CS Home Hub!");

  pinMode(up, INPUT_PULLUP);
  pinMode(down, INPUT_PULLUP);
  pinMode(right, INPUT_PULLUP);
  pinMode(left, INPUT_PULLUP);
  pinMode(a, INPUT_PULLUP);
  pinMode(b, INPUT_PULLUP);

  //Start-up OLED Screen
  Serial.println("Initializing Screen");
  if (!display.begin(SSD1306_SWITCHCAPVCC, 0x3C)) {
    Serial.println(F("SSD1306 allocation failed"));
    //for (;;); // Don't proceed, loop forever
  }
  // Clear screen buffer
  display.clearDisplay();

  //CS Logo Animation
  drawCS();    // Draw's City Science Logo
  display.invertDisplay(true);
  delay(3000);
  display.invertDisplay(false);
  delay(3000);
  display.clearDisplay();
  display.setTextSize(1);
  display.setTextColor(WHITE);
  display.setCursor(0, 10);

  // Display Welcome Text
  display.println("Inicializando HomeHub"); //"Welcome to Home  Hub"
  display.display();
  delay(2000);

  WiFi.mode(WIFI_AP_STA); //Optional
  display.clearDisplay();
  display.print("Conectando a WiFi"); //"Connecting to Wifi"
  Serial.print("Connecting to WiFi");
  display.display();
  delay(2000);

  WiFi.begin(ssid, password);

  while (WiFi.status() != WL_CONNECTED) { // Check wi-fi is connected to wi-fi network
    delay(1000);
    Serial.print(".");
    display.print(".");
    display.display();
  }
  display.clearDisplay();
  display.println(" ");
  display.print("Conectado a: "); //"Connected to: "
  display.println(ssid);
  display.print("Mi IP "); //"My IP Address is "
  display.println(WiFi.localIP());
  display.println(WiFi.macAddress());
  display.display();
  Serial.println("");
  Serial.println("WiFi connected successfully");
  Serial.print("Got IP: ");
  Serial.println(WiFi.localIP());  //Show ESP32 IP on serial
  Serial.print("Mi MAC Address: ");
  Serial.println(WiFi.macAddress());
  Serial.print("Wi-Fi Channel: ");
  Serial.println(WiFi.channel());

  Serial.println("Starting ESP NOW Communication");
  if (esp_now_init() != ESP_OK) {
    Serial.println("Error initializing ESP-NOW");
    return;
  }

  esp_now_register_recv_cb(OnDataRecv);

  //Get weather and location.
  Serial.println("Getting Weather and Location");
  get_system_stats();
  String greeting = dev_name;
  get_complete_weather();

  //Initialize time server
  Serial.println("Initializing Time Server");
  timeClient.begin();
  Serial.println("Time client started");
  timeClient.setTimeOffset(timezone); // +-3600 per hour difference against GMT.

  //sent_time = 0;
  sending_climate = true;
  server_send();
  Serial.println(greeting);
  display.clearDisplay();
  display.setCursor(0, 4);
  display.setTextSize(2);
  display.println("Hola");
  display.println(greeting + "!");
  display.display();
    
  delay(3000);
  draw_maindash();
  Serial.println("Setup is complete!");

}


//GPIO27 -> Up
//GPIO15 -> Down
//GPIO13 -> Right
//GPIO14 -> Left
//GPIO4 -> B
//GPIO2 -> A

void loop() {

  current_time = millis();
  elapsed_time = current_time - sent_time;
  if (elapsed_time >= 28800000) { //Updates and Sends Climate Data every 8 hours
    sending_climate = true;
    server_send();
    Serial.println("Sent Climate Data To Server");
  }

  if ((WiFi.status() != WL_CONNECTED) && (current_time - previousMillis >=interval)) {
    Serial.println("Reconnecting to WiFi!");
    WiFi.disconnect();
    WiFi.reconnect();
    previousMillis = current_time;
  } 

  if (received_message) {
    draw_receiveddata();
    server_send();
    received_message = false;
  }
  if (get_buttons() == 1) { //Shows Clock Screen When Up Arrow is Pressed
    sending_activity = true;
    activity = 1;
    draw_clockdash();
    server_send();
    sending_activity = false;
    
  }
  if (get_buttons() == 2) { //Shows Water Dashboard
    sending_activity = true;
    activity = 2;
    draw_waterdash();
    server_send();
    sending_activity = false;
  }
  if (get_buttons() == 3) { //Shows Virtual Axol
    sending_activity = true;
    activity = 3;
    draw_axol();
    server_send();
    sending_activity = false;
  }
  if (get_buttons() == 4) { //Clear Display
    sending_activity = true;
    activity = 4;
    draw_system();
    server_send();
    sending_activity = false;
  }
  if (get_buttons() == 5) { //Clear Display
    sending_activity = true;
    activity = 5;
    display.clearDisplay();
    server_send();
    sending_activity = false;
  }
}


int get_buttons() { //Funtion returns int from 1 - 6

  /*
     1 - Up
     2 - Down
     3 - Right
     4 - Left
     5 - A
     6 - B
  */

  int touch_delay = 300;
  display.clearDisplay();

  if (!digitalRead(up)) {
    //delay(touch_delay);
    //Serial.println(up_cap);
    return 1;
    //display.clearDisplay();
  }

  else if (!digitalRead(down)) {
    //delay(touch_delay);
    return 2;
    //display.clearDisplay();
  }

  else if (!digitalRead(right)) {
    //delay(touch_delay);
    //display.clearDisplay();
    return 3;
  }

  else if (!digitalRead(left)) {
    //delay(touch_delay);
    return 4;
    //display.clearDisplay();
  }

  else if (!digitalRead(a)) {
    //delay(touch_delay);
    return 5;
    //display.clearDisplay();
  }
  else if (!digitalRead(b)) {
    //delay(touch_delay);
    return 6;
    //display.clearDisplay();
  }
}

void get_time() { //Functiuons queries server to get current time. Activates time screen.

  while (!timeClient.update()) {

    timeClient.forceUpdate();

  }

  // The formattedDate comes with the following format:
  // 2018-05-28T16:00:13Z
  // We need to extract date and time
  formattedDate = timeClient.getFormattedDate();
  Serial.println(formattedDate); //Variable for Timestamps

  // Extract date
  int splitT = formattedDate.indexOf("T");
  dayStamp = formattedDate.substring(0, splitT);
  Serial.print("DATE: ");
  Serial.println(dayStamp);
  // Extract time
  timeStamp = formattedDate.substring(splitT + 1, formattedDate.length() - 4);
  Serial.print("HOUR: ");
  Serial.println(timeStamp);

}

void drawCS() { //Draws CS Logo
  display.clearDisplay();
  display.drawBitmap(
    (display.width()  - LOGO_WIDTH ) / 2,
    (display.height() - LOGO_HEIGHT) / 2,
    cs_logo_bmp, LOGO_WIDTH, LOGO_HEIGHT, 1);
  display.display();
  delay(1000);
}

void draw_axol() { //Draws Axol
  get_system_stats();
  
  display.clearDisplay();
  if (fill_percentage >= .5) {
    display.drawBitmap(
    (display.width()  - 108 ) / 2,
    (display.height() - 60) / 2,
    happy_axol_bmp, 108, 60, 1);
    display.display();
    
  } else {
    display.drawBitmap(
    (display.width()  - 125 ) / 2,
    (display.height() - 60) / 2,
    sad_axol_bmp, 125, 60, 1);
    display.display();
  }
  
  delay(5000);
  draw_maindash();
  
}

void draw_weather_icon(const unsigned char icon[], int width, int height) {
  display.drawBitmap(
    (display.width() - width),
    (display.height() - height),
    icon, width, height, 1);
}

void draw_waterdash () { //Function Draws Dashboard with loction, weather and time information.

  get_system_stats();
  
  int16_t x1;
  int16_t y1;
  uint16_t width;
  uint16_t height;  
  
  //Serial.println(remaining_average);
  display.clearDisplay();
  display.setTextSize(2);
  display.setTextColor(WHITE);
  display.setCursor(0, 0);
  display.print("Reservas: ");
  display.print(fill_percentage * 100);
  display.println(" %");
  display.setTextSize(1);
  display.println("");
  display.print(avail_liters);
  display.print("/");
  display.print(avail_storage);
  display.println(" L ");
  display.println("Displonibles");

  //water quality dashboard!!!!!!!!!!!!!!!!!
  
  /*if (remaining_average >= water_goal) {
    draw_water_icon(happy_drop_bmp, WWIDTH, WHEIGHT);
  }
  if (remaining_average <= water_goal) {
    draw_water_icon(sad_drop_bmp, WWIDTH, WHEIGHT);
  } */
  display.display();

  delay(5000);
  draw_maindash();
}

void draw_system() {
  int16_t x1;
  int16_t y1;
  uint16_t width;
  uint16_t height;  
  //Serial.println(remaining_average);
  display.clearDisplay();
  display.setTextSize(2);
  display.setTextColor(WHITE);
  display.setCursor(0, 0);
  display.println("Sensores");
  display.println("");
  display.setTextSize(1.5);
  display.print("Cubetas: ");
  display.println(buckets);
  display.print("Tanques: ");
  display.println(tanks);
  display.print("Calidad: ");
  display.println(quality);
  display.print("Ambiente: ");
  display.println(envs);

  display.display();

  delay(5000);
  draw_maindash();
  
}

void draw_receiveddata() {

  display.clearDisplay();
  for (int16_t i = max(display.width(), display.height()) / 2; i > 0; i -= 3) {
    // The INVERSE color is used so circles alternate white/black
    display.fillCircle(display.width() / 2, display.height() / 2, i, SSD1306_INVERSE);
    display.display(); // Update screen with each newly-drawn circle
    delay(1);
  }

  draw_maindash();

}

void draw_maindash() { //Turn Screen Off
  display.clearDisplay();
  display.display();
}

void draw_clockdash() {

  get_time();
  get_complete_weather();

  int16_t x1;
  int16_t y1;
  uint16_t width;
  uint16_t height;

  display.clearDisplay();
  display.setTextSize(2.5);
  display.setTextColor(WHITE);
  //Gents Center for Date
  display.getTextBounds(timeStamp, 0, 0, &x1, &y1, &width, &height);
  display.setCursor(0, 5);
  display.println(timeStamp);

  display.setTextSize(.9);
  display.getTextBounds(dayStamp, 0, 0, &x1, &y1, &width, &height);
  display.setCursor(0, 25);
  display.println(dayStamp);

  display.setTextSize(0);
  display.getTextBounds(city_name, 0, 0, &x1, &y1, &width, &height);
  display.setCursor(0, 55);
  display.println(city_name);

  int d_temp = round(main_temp - 272.15);
  int d_max = round(main_temp_max - 272.15);
  int d_min = round(main_temp_min - 272.15);

  display.setTextSize(2);
  String display_temp = String(d_temp) + "C" ;
  display.getTextBounds(display_temp, 0, 0, &x1, &y1, &width, &height);
  display.setCursor(SCREEN_WIDTH - width, 5);
  display.println(display_temp);

  display.setTextSize(.9);
  String display_range = String(d_min) + "C / " + String(d_max) + "C";
  display.getTextBounds(display_range, 0, 0, &x1, &y1, &width, &height);
  display.setCursor(SCREEN_WIDTH - width, 25);
  display.println(display_range);

  if ((String(weather_0_icon) == "04d") || (String(weather_0_icon) == "04n") || (String(weather_0_icon) == "03n") || (String(weather_0_icon) == "03d") ) { //Clouds
    draw_weather_icon(cloud_bmp, 30, 16);
  } else if ((String(weather_0_icon) == "01d") || (String(weather_0_icon) == "01n") || (String(weather_0_icon) == "02n") || (String(weather_0_icon) == "02d")) { //Sun
    draw_weather_icon(sun_bmp, 30, 30);
  } else if ((String(weather_0_icon) == "09d") || (String(weather_0_icon) == "09n") || (String(weather_0_icon) == "10d") || (String(weather_0_icon) == "10n") ) { //Rain
    draw_weather_icon(rain_bmp, 30, 25);
  } else if ((String(weather_0_icon) == "11d") || (String(weather_0_icon) == "11n")) { //Storm
    draw_weather_icon(storm_bmp, 30, 30);
  } else if ((String(weather_0_icon) == "13d") || (String(weather_0_icon) == "13n")) { //Snow
    draw_weather_icon(snow_bmp, 30, 30);
  } else { //Could be mist or other conditions.

  }

  display.display();
  delay(3500);

  draw_maindash();

}


void get_complete_weather() { //gets weather and location information.
  
  const String endpoint = "https://api.openweathermap.org/data/2.5/weather?lat=" + String(lat, 7) + "&lon=" + String(lon, 7) + "&appid=";
  const String key = "df45df8f631d3860f77ad3f9feafc1cb";
  
  HTTPClient http;

  http.begin(endpoint + key); //construct the URL
  Serial.println(endpoint + key);
  int httpCode = http.GET();  //send request

  if (httpCode > 0) {  //If received weather JSON

    String payload = http.getString();
    Serial.println(payload);

    DeserializationError error = deserializeJson(doc, payload);

    if (error) {
      Serial.print("deserializeJson() failed: ");
      Serial.println(error.c_str());
      return;
    }

    coord_lon = doc["coord"]["lon"];
    coord_lat = doc["coord"]["lat"];

    weather_0 = doc["weather"][0];
    weather_0_id = weather_0["id"];
    weather_0_main = weather_0["main"];
    weather_0_description = weather_0["description"];
    weather_0_icon = weather_0["icon"];

    base = doc["base"];

    main1 = doc["main"];
    main_temp = main1["temp"];
    main_feels_like = main1["feels_like"];
    main_temp_min = main1["temp_min"];
    main_temp_max = main1["temp_max"];
    main_pressure = main1["pressure"];
    main_humidity = main1["humidity"];
    main_sea_level = main1["sea_level"];
    main_grnd_level = main1["grnd_level"];

    visibility = doc["visibility"];

    wind = doc["wind"];
    wind_speed = wind["speed"];
    wind_deg = wind["deg"];
    wind_gust = wind["gust"];

    clouds_all = doc["clouds"]["all"];

    dt = doc["dt"];

    sys = doc["sys"];
    sys_type = sys["type"];
    sys_id = sys["id"];
    sys_country = sys["country"];
    sys_sunrise = sys["sunrise"];
    sys_sunset = sys["sunset"];

    timezone = doc["timezone"];
    id = doc["id"]; // 6692163
    city_name = doc["name"];
    cod = doc["cod"];

  }

  else {
    Serial.println("Error fetching weather and location information. =( ");
  }

  http.end();
}

void OnDataRecv(const uint8_t * mac, const uint8_t *incomingData, int len) { //Fucntion is activated when ESP receives data on ESPNOW.
  //It copies the received message to memory and sets the received message variable to True to indicate that there is new data to be sent to the server.
  memcpy(&myData, incomingData, sizeof(myData));
  received_message = true;
}

void server_send() { //Sends data to php script on server.
  //The function checks to see if the command is for the regular homehub climate updates or if the command is comming from a known connected sensor.
  //Case Switch function creates different php command depending on the type of sensor that the data corresponds to.

  String command;

  if (sending_climate) {
    get_time();
    get_complete_weather();
    command = {"type=0&id=" + WiFi.macAddress() + "&temp=" + main_temp + "&min_temp=" + main_temp_min +
               "&max_temp=" + main_temp_max + "&weather_main=" + weather_0_main + "&weather_description=" +
               weather_0_description + "&pressure=" + main_pressure + "&humidity=" + main_humidity +
               "&wind_speed=" + wind_speed + "&wind_direction=" + wind_deg + "&datetime=" + formattedDate
              } ;
    connect_send(command);
    sent_time = millis();
    sending_climate = false;

  }
  
  if (sending_activity) {
    
    get_time();
    command = "type=5&id=" + WiFi.macAddress() + "&activity=" + activity + "&datetime=" + formattedDate;
    Serial.println(command);
    connect_send(command);
    
  } else {

    switch (myData.type) {

      case 1: { //Bucket Sensor
          get_time();
          String send_id = myData.id;
          command = "type=1&id=" + send_id + "&datetime=" + formattedDate;
          Serial.println(command);
          connect_send(command);
        }
        break;

      case 2: //Tank Sensor
        {
          get_time();
          String send_id = myData.id;
          command = "type=2&id=" + send_id + "&water_distance=" + myData.data1 +  "&datetime=" + formattedDate;
          Serial.println(command);
          connect_send(command);
        } 
        break;
       
       case 3: //Temp Humidity Sensor
       {
        get_time();
        String send_id = myData.id;
        command = "type=3&id=" + send_id + "&temp=" + myData.data1 + "&humidity=" + myData.data2 + "&datetime=" + formattedDate;
        Serial.println(command);
        connect_send(command);
       }

       case 4: //Water Quality Sensor
       {
        get_time();
        String send_id = myData.id;
        command = "type=4&id=" + send_id + "&tds=" + myData.data1 + "&water_temp=" + myData.data2 + "&datetime=" + formattedDate;
        Serial.println(command);
        connect_send(command);
       }
       break;
    }

  }

}

void connect_send(String php_command) { //Send Data to PHP server
  //Function takes command as argument and sends a POST request to server.

  HTTPClient http;
  WiFiClient client;

  String server_main = "http://blindspot.media.mit.edu/homehub.php";

  http.begin(client, server_main);

  http.addHeader("Content-Type", "application/x-www-form-urlencoded");
  String httpRequestData = php_command;

  int httpResponseCode = http.POST(httpRequestData);

  if (httpResponseCode > 0) {
    Serial.print("HTTP Response code: ");
    Serial.println(httpResponseCode);
    String payload = http.getString();
    Serial.println(payload);
  }
  else {
    Serial.print("Error code: ");
    Serial.println(httpResponseCode);
  }
  // Free resources
  http.end();
}

void get_system_stats() { //Send Data to PHP server
  //Function takes command as argument and sends a POST request to server.

  HTTPClient http;

  String server_main = "http://blindspot.media.mit.edu/homehubweb/hhdash.php?id=" + WiFi.macAddress();

  http.begin(server_main); //construct the URL
  Serial.println(server_main);
  int httpCode = http.GET();  //send request

  if (httpCode > 0) {  //If received weather JSON

    String payload = http.getString();
    Serial.println(payload);

    DeserializationError error = deserializeJson(doc, payload);

    if (error) {
      Serial.print("deserializeJson() failed: ");
      Serial.println(error.c_str());
      return;
    }

  fill_percentage = doc["percentage"];
  buckets = doc["bucketNum"];
  tanks = doc["tankNum"];
  avail_storage = doc["availStorage"];
  avail_liters = doc["availLiters"];
  quality = doc["qualityNum"];
  envs = doc["envNum"];
  dev_name = doc["name"];
  lat = doc["lat"];
  lon = doc["lon"];
  
  
  // Free resources
  http.end();
 } 
 else {
    Serial.print("Error code: ");
    Serial.println(httpCode);
  }
}
